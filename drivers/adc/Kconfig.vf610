## drivers/adc/Kconfig.vf610
```kconfig
# ADC configuration options

# SPDX-License-Identifier: Apache-2.0

config ADC_VF610
	bool "VF610 ADC driver"
	depends on HAS_VF610_ADC
	help
	  Enable the VF610 ADC driver.

if ADC_VF610

choice
	prompt "Clock Source Select"
	default ADC_VF610_CLK_IPG_DIV_2

config ADC_VF610_CLK_IPG
	bool "Clock source from IPG"

config ADC_VF610_CLK_IPG_DIV_2
	bool "Clock source from IPG divided by 2"

config ADC_VF610_CLK_ADACK
	bool "Clock source from ADACK"

endchoice

choice
	prompt "Clock Divide Selection"
	default ADC_VF610_CLK_DIV_RATIO_4

config ADC_VF610_CLK_DIV_RATIO_1
	bool "Divide ratio is 1"

config ADC_VF610_CLK_DIV_RATIO_2
	bool "Divide ratio is 2"

config ADC_VF610_CLK_DIV_RATIO_4
	bool "Divide ratio is 4"

config ADC_VF610_CLK_DIV_RATIO_8
	bool "Divide ratio is 8"

endchoice

endif # ADC_VF610
```

## drivers/watchdog/Kconfig.imx
```kconfig
# Watchdog configuration options

# Copyright (c) 2022, Antonio Tessarolo
# SPDX-License-Identifier: Apache-2.0

config WDT_IMX
	bool "IMX WDOG driver"
	depends on HAS_IMX_WDT
	help
	  Enable the imx wdog driver.

if WDT_IMX

config WDT_IMX_RESET_PLATFORM
    bool "Reset all platform"
    default y
    help
        Reset all processor and not only the core who is running zephyr

config WDT_IMX_INT_TIMEOUT
    int "isr timeout milliseconds"
    default 2000
    help
        Configure the timeout of the ISR that precede watchdog trigger

endif # ADC_VF610
```

## dts/bindings/iio/adc/nxp,vf610-adc.yaml
```yaml
# SPDX-License-Identifier: Apache-2.0

description: Vf610 Adc

compatible: "nxp,vf610-adc"

include: adc-controller.yaml

properties:
    reg:
      required: true

    interrupts:
      required: true

    "#io-channel-cells":
      const: 1

    rdc:
      type: int
      required: true
      description: Set the RDC permission for this peripheral

io-channel-cells:
    - input
```

## dts/bindings/watchdog/fsl,imx21-wdt.yaml
```yaml
# Copyright (c) 2022, Antonio Tessarolo
# SPDX-License-Identifier: Apache-2.0

description: IMX watchdog

compatible: "fsl,imx21-wdt"

include: base.yaml

properties:
    reg:
      required: true

    label:
      required: true

    interrupts:
      required: true
```
